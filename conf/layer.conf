## conf/layer.conf
```bitbake
# We have a conf and classes directory, add to BBPATH
BBPATH .= ":${LAYERDIR}"

# We have recipes-* directories, add to BBFILES
BBFILES += "${LAYERDIR}/recipes-*/*/*.bb \
    ${LAYERDIR}/recipes-*/*/*.bbappend \
    ${LAYERDIR}/*.bb"

BBFILE_COLLECTIONS += "meta-kumbaya"
BBFILE_PATTERN_meta-kumbaya = "^${LAYERDIR}/"
LAYERSERIES_COMPAT_meta-kumbaya = "zeus"
BBFILE_PRIORITY_meta-kumbaya = "99"
```

## conf/machine/kumbaya-imx6dl.conf
```bitbake
#@TYPE: Machine
#@NAME: NXP i.MX6DL SABRE Smart Device
#@SOC: i.MX6DL
#@DESCRIPTION: Machine configuration for NXP i.MX6DL SABRE Smart Device
#@MAINTAINER: Otavio Salvador <otavio@ossystems.com.br>

MACHINEOVERRIDES =. "mx6:mx6dl:"

require conf/machine/include/imx6sabresd-common.inc

KERNEL_DEVICETREE = "imx6dl-sabresd.dtb"

PREFERRED_PROVIDER_u-boot = "u-boot-imx"
PREFERRED_PROVIDER_virtual/bootloader = "u-boot-imx"
PREFERRED_PROVIDER_virtual/kernel = "linux-imx"

UBOOT_CONFIG = "sd"
UBOOT_CONFIG[sd] = "mx6dlsabresd_defconfig,sdcard"

MACHINE_FIRMWARE += "firmware-imx-epdc"
```
